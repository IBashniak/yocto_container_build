## build/conf/bblayers.conf
```bitbake
# POKY_BBLAYERS_CONF_VERSION is increased each time build/conf/bblayers.conf
# changes incompatibly
POKY_BBLAYERS_CONF_VERSION = "2"

BBPATH = "${TOPDIR}"
BBFILES ?= ""

BBLAYERS ?= " \
  /home/build/amigo_workspace/sources/poky/meta \
  /home/build/amigo_workspace/sources/meta-openembedded/meta-networking \
  /home/build/amigo_workspace/sources/meta-openembedded/meta-python \
  /home/build/amigo_workspace/sources/meta-openembedded/meta-oe \
  /home/build/amigo_workspace/sources/meta-raspberrypi \
  /home/build/amigo_workspace/sources/meta-qt5 \
  /home/build/amigo_workspace/sources/poky/meta-poky \
  /home/build/amigo_workspace/sources/poky/meta-yocto-bsp \
  /home/build/amigo_workspace/sources/meta-amigo-rpi \
  "
```

## sources/meta-amigo-rpi/conf/distro/amigodistro.conf
```bitbake
# Distro Layer configuration
# include and overwrite default poky distro
include conf/distro/poky.conf

DISTRO = "amigodistro"
DISTRO_NAME = "amigodistro-Linux"
DISTRO_VERSION = "1.0"
DISTRO_CODENAME = "amigo"
SDK_VENDOR = "-amigosdk"
SDK_VERSION="${DISTRO_VERSION}"
MAINTAINER = "amigo@mail.com"

TARGET_VENDOR = "-amigodistro"

# Override these in poky based distros
MYDISTRO_DEFAULT_DISTRO_FEATURES = "bluetooth ext2 usbgadget usbhost wifi xattr nfs zeroconf 3g"
#MYDISTRO_DEFAULT_EXTRA_RDEPENDS = "packagegroup-core-boot"
#MYDISTRO_DEFAULT_EXTRA_RRECOMMENDS = "kernel-module-af-packet"
#
#DISTRO_EXTRA_RDEPENDS += " ${MYDISTRO_DEFAULT_EXTRA_RDEPENDS}"
#DISTRO_EXTRA_RRECOMMENDS += " ${MYDISTO_DEFAULT_EXTRA_RRECOMMENDS}"

DISTRO_FEATURES ?= "${MYDISTRO_DEFAULT_DISTRO_FEATURES} ${DISTRO_FEATURES_LIBC} "

INIT_MANAGER = "systemd"

#PACKAGE_CLASSES = "package_ipk"

# Use systemd as init manager
#DISTRO_FEATURES:append = " systemd"
DISTRO_FEATURES:REMOVE += "sysvinit"
DISTRO_FEATURES:REMOVE += "busybox"
DISTRO_FEATURES_BACKFILL_CONSIDERED += "sysvinit "
DISTRO_FEATURES_BACKFILL_CONSIDERED += "busybox "
VIRTUAL-RUNTIME_init_manager = "systemd"
VIRTUAL-RUNTIME_initscripts = "systemd-compat-units"

hostname_pn-base-files = "amigo"
DISTRO_FEATURES:REMOVE += "vulkan pulseaudio bluez5 pcmci 3g nfc wayland"
DISTRO_FEATURES:REMOVE += "ptest"
DISTRO_FEATURES:REMOVE += "x11"
DISTRO_FEATURES:APPEND += " eglfs opengl"
DISTRO_FEATURES:APPEND += " usbhost ${DISTRO_FEATURES_LIBC}"
```

## sources/meta-amigo-rpi/conf/layer.conf
```bitbake
# We have a conf and classes directory, add to BBPATH
BBPATH .= ":${LAYERDIR}"

# We have recipes-* directories, add to BBFILES
BBFILES += "${LAYERDIR}/recipes-*/*/*.bb \
            ${LAYERDIR}/recipes-*/*/*.bbappend"

BBFILE_COLLECTIONS += "meta-amigo-rpi"
BBFILE_PATTERN_meta-amigo-rpi = "^${LAYERDIR}/"
BBFILE_PRIORITY_meta-amigo-rpi = "6"

LAYERDEPENDS_meta-amigo-rpi = "core"
LAYERSERIES_COMPAT_meta-amigo-rpi = "kirkstone"
```

## sources/meta-amigo-rpi/conf/machine/containerx86-64.conf
```bitbake
#@TYPE: Machine
#@NAME: Container X86_64.

#@DESCRIPTION: Machine configuration for generic X86_64 (64-bit) containers. Does not include a kernel!

#DEFAULTTUNE ?= "core2-64"
#require conf/machine/include/x86/tune-core2.inc

#MACHINEOVERRIDES =. "intel-skylake-64:"

DEFAULTTUNE ?= "skylake-64"
require conf/machine/include/tune-skylake.inc

PREFERRED_PROVIDER_virtual/kernel ?= "linux-dummy"

IMAGE_TYPE = "container"

# to use 
# docker import amigo-container-image-containerx86-64.tar.gz amigo
# docker run -it --rm amigo /bin/bash
# starting point https://github.com/TheYoctoJester/meta-containerization.git
```
